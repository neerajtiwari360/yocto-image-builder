## yocto/layers/meta-kv260-vision/conf/layer.conf
```bitbake
BBPATH .= ":${LAYERDIR}"
BBFILES += "${LAYERDIR}/recipes-*/*/*.bb ${LAYERDIR}/recipes-*/*/*.bbappend"
BBFILE_COLLECTIONS += "kv260-vision"
BBFILE_PATTERN_kv260-vision = "^${LAYERDIR}/"
BBFILE_PRIORITY_kv260-vision = "8"
LAYERSERIES_COMPAT_kv260-vision = "scarthgap"
LAYERDEPENDS_kv260-vision = "core xilinx kv260 openembedded-layer vitis-ai"
```

## yocto/layers/meta-kv260/conf/layer.conf
```bitbake
BBPATH .= ":${LAYERDIR}"
BBFILES += "${LAYERDIR}/recipes-*/*/*.bb ${LAYERDIR}/recipes-*/*/*.bbappend"
BBFILE_COLLECTIONS += "kv260"
BBFILE_PATTERN_kv260 = "^${LAYERDIR}/"
BBFILE_PRIORITY_kv260 = "7"
LAYERSERIES_COMPAT_kv260 = "scarthgap"
LAYERDEPENDS_kv260 = "core xilinx"
```

## yocto/layers/meta-product/conf/layer.conf
```bitbake
BBPATH .= ":${LAYERDIR}"
BBFILES += "${LAYERDIR}/recipes-*/*/*.bb"
BBFILE_COLLECTIONS += "product"
BBFILE_PATTERN_product = "^${LAYERDIR}/"
BBFILE_PRIORITY_product = "6"
LAYERSERIES_COMPAT_product = "scarthgap"
LAYERDEPENDS_product = "core"
```
